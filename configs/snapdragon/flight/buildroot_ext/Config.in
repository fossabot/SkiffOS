## configs/snapdragon/flight/buildroot_ext/Config.in
```kconfig
source "$BR2_EXTERNAL_SNAPDRAGON_FLIGHT_PATH/boot/lk/Config.in"
source "$BR2_EXTERNAL_SNAPDRAGON_FLIGHT_PATH/package/platform-system-core/Config.in.host"
```

## configs/snapdragon/flight/buildroot_ext/boot/lk/Config.in
```kconfig
config BR2_TARGET_LK
	bool "Little-kernel"
	help
	  Build "Little Kernel" Boot Loader

#if BR2_TARGET_LK

config BR2_TARGET_LK_BOARDNAME
	string "LK board name"
	help
	  One of lk supported board targets to be built.

config BR2_TARGET_LK_TARBALL_LOCATION
	string "URL of Lk sources tarball"

#endif
```

## configs/snapdragon/flight/buildroot_ext/package/platform-system-core/Config.in.host
```kconfig
config BR2_PACKAGE_HOST_PLATFORM_SYSTEM_CORE
	bool "host platform system core tools"
	help
	  Build the host qualcomm platform system core tools.
```
